#include <driver/dac.h>
#include "FastDAC.h"
int xres = 127; //16-1
int yres = 127; //16-1
byte xval[128][128];
byte yval[128][128];

byte imgData1[] PROGMEM = {//flower128
  0xFF, 0xFF, 0xFF, 0xFF, 0xDF, 0xEF, 0xEF, 0xFF, 0xFF, 0xFF, 0xFF, 0xFF, 
  0xFF, 0xFF, 0xFF, 0xFF, 0xFF, 0xFF, 0xFF, 0xFF, 0xFF, 0xFE, 0xFF, 0xFE, 
  0xFF, 0xFF, 0xFF, 0xFF, 0xFF, 0xFF, 0xFF, 0xFF, 0xFF, 0xFF, 0xFF, 0xFF, 
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  0xFF, 0xFF, 0xFF, 0xFF, 0xFF, 0xFF, 0xFE, 0xFF
}; 
byte imgData[] PROGMEM = {//flor64
  0xFF, 0xFF, 0xDF, 0x7B, 0xFF, 0xFF, 0xFF, 0xFF, 0xFF, 0xFF, 0xFF, 0xFF, 
  0xFF, 0xFF, 0xFF, 0xFF, 0xFF, 0xFF, 0xFF, 0xFE, 0xFF, 0xFF, 0xFF, 0xFF, 
  0xFF, 0xFF, 0xBF, 0xFF, 0xFF, 0xFF, 0xFF, 0xFF, 0xFF, 0xFF, 0xFF, 0xDF, 
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  0xFF, 0xFF, 0xFF, 0xFF, 0xFF, 0xFF, 0xFF, 0xFF,
}; 

byte imgData2[] PROGMEM = {//smile
  0xc0, 0x07, 0x30, 0x18, 0x08, 0x20, 0x04, 0x40, 0x44, 0x44, 0x02, 0x80,
             0x02, 0x80, 0x02, 0x80, 0x22, 0x88, 0x62, 0x8c, 0xc4, 0x47, 0x04, 0x40,
             0x08, 0x20, 0x30, 0x18, 0xc0, 0x07, 0x00, 0x00
}; 


void setup() {
  dac_output_enable(DAC_CHANNEL_1);
  dac_output_enable(DAC_CHANNEL_2);
  Serial.begin(115200);
 rtc_clk_cpu_freq_set(RTC_CPU_FREQ_240M);
  Serial.println("CPU Clockspeed: ");
  Serial.println(rtc_clk_cpu_freq_value(rtc_clk_cpu_freq_get()));
  displayOsci(imgData1, xres, yres);

}
//TESTAR RODAR FUNÇÃO E PREENCHER VETORES NO INICIO, LOOP WRITE VALORES
void displayOsci(byte * frame, int xres, int yres){
int i,j,k,z,yi=yres,stp=(int)((yres+1)/8.0),y2=stp*yres+1;
  for(k =y2; k >= 0; k-=stp){//yress=31
      z=k;
      for(j = 0;j <=xres ; j++){
        i=j;
        if(j>=8){
           i=j-8*(int)(j/8.0);
          z=k-(int)(j/8) ;
        }
        byte mask = 0x01 << i;
        byte answer = (frame[y2-z] & mask) >> i;
       // Serial.println(answer);
        if (answer != 0x01) {//!=0x01
          xval[j][yi]=(round((float)j * 255.0 / (float)xres));//dac_output_voltage(DAC_CHANNEL_1, round((float)j * 255.0 / (float)xres));
          yval[j][yi]=(round((float)yi * 255.0 / (float)yres));//dac_output_voltage(DAC_CHANNEL_2, round((float)yi * 255.0 / (float)yres));
           /*Serial.print("j:");
           Serial.println(j);
           Serial.print("yi:");
           Serial.println(yi);*/
         // delayMicroseconds(100);
        }
        else{
          xval[j][yi]=-1;
        }
      }
    yi=yi-1;
  }
}



void loop() {
   DACPrepare(true);
  int i,j;
  for(i =yres; i >= 0; i--){
      for(j = 0;j <=xres ; j++){
        if((xval[j][i]!=-1)){
          DAC1Write(xval[j][i]);//dac_output_voltage(DAC_CHANNEL_1, xval[j][i]);
          DAC2Write(yval[j][i]);//dac_output_voltage(DAC_CHANNEL_2, yval[j][i]);
           /*Serial.print("x:");
           Serial.println(xval[j][i]);
           Serial.print("y:");
           Serial.println(yval[j][i]);*/
          delayMicroseconds(10);
        }
        
      }
  }
   DACUnprepare(true);
}
