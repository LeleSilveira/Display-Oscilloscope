#include <driver/dac.h>
#include "FastDAC.h"
int xres = 95; //16-1
int yres = 95; //16-1
byte xval[96][96];
byte yval[96][96];
hw_timer_t * timer = NULL;
//int total=0;

byte imgData1[] PROGMEM = {//flor64
  0xFF, 0xFF, 0xDF, 0x7B, 0xFF, 0xFF, 0xFF, 0xFF, 0xFF, 0xFF, 0xFF, 0xFF, 
  0xFF, 0xFF, 0xFF, 0xFF, 0xFF, 0xFF, 0xFF, 0xFE, 0xFF, 0xFF, 0xFF, 0xFF, 
  0xFF, 0xFF, 0xBF, 0xFF, 0xFF, 0xFF, 0xFF, 0xFF, 0xFF, 0xFF, 0xFF, 0xDF, 
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  0xFF, 0xFF, 0xFF, 0xFF, 0xFF, 0xFF, 0xFF, 0xFF,
}; 


byte imgData2[] PROGMEM = {//flor32
  0xFF, 0xFF, 0xFF, 0xFF, 0xFF, 0xFF, 0xFE, 0xFF, 0xFF, 0xFF, 0xFF, 0xFF, 
  0xFF, 0xDF, 0xFF, 0xFF, 0xFF, 0xFF, 0xFF, 0xFF, 0xFD, 0x3F, 0xF7, 0xFF, 
  0xFF, 0x17, 0xE3, 0xFF, 0xFF, 0x01, 0xE0, 0xFF, 0xFF, 0x02, 0x80, 0xFF, 
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  0xFF, 0xFF, 0xFF, 0xFF, 0xFF, 0xFF, 0xFF, 0xFF,
}; 

byte imgData3[] PROGMEM = {//dog96
  0xFF, 0xFF, 0xFF, 0x00, 0xF0, 0xFF, 0xFF, 0xFF, 0x0F, 0x00, 0xFE, 0xFF, 
  0xFF, 0xFF, 0xFF, 0x00, 0xF0, 0xFF, 0xFF, 0xFF, 0x1F, 0x00, 0xFF, 0xFF, 
  0xFF, 0xFF, 0x7F, 0x00, 0xF0, 0xFF, 0xFF, 0xFF, 0x0F, 0x00, 0xFE, 0xFF, 
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  0xFF, 0xFF, 0xFF, 0x7F, 0x09, 0x00, 0x00, 0x00, 0xC0, 0xFF, 0xFF, 0xFF, 
}; 

byte imgData4[] PROGMEM = {//dog32
  0xFF, 0xF0, 0x7F, 0xF8, 0x7F, 0xE0, 0x3F, 0xF8, 0x7F, 0xE0, 0x3F, 0xF8, 
  0x7F, 0xE2, 0x1F, 0xF8, 0x3F, 0xC1, 0x9F, 0xF8, 0x3F, 0xE4, 0x3F, 0xF8, 
  0x3F, 0xF3, 0x3F, 0xE0, 0x1F, 0xBA, 0xFF, 0xE0, 0x1F, 0xF8, 0x10, 0xC0, 
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  0xFF, 0x03, 0x00, 0xFF, 0xFF, 0x03, 0x00, 0xFF,
}; 
void IRAM_ATTR onTimer() {
   DACPrepare(true);
  int i,j;
  for(i =yres; i >= 0; i--){
      for(j = 0;j <=xres ; j++){
        if((xval[j][i]!=-1)){
          DAC1Write(xval[j][i]);//dac_output_voltage(DAC_CHANNEL_1, xval[j][i]);
          DAC2Write(yval[j][i]);//dac_output_voltage(DAC_CHANNEL_2, yval[j][i]);
           /*Serial.print("x:");
           Serial.println(xval[j][i]);
           Serial.print("y:");
           Serial.println(yval[j][i]);*/
           delay(3);
        }
        
      }
  }
   DACUnprepare(true);
}


void setup() {
  dac_output_enable(DAC_CHANNEL_1);
  dac_output_enable(DAC_CHANNEL_2);
  Serial.begin(115200);
 rtc_clk_cpu_freq_set(RTC_CPU_FREQ_240M);
  Serial.println("CPU Clockspeed: ");
  Serial.println(rtc_clk_cpu_freq_value(rtc_clk_cpu_freq_get()));
  displayOsci(imgData3,95, 95,255.0,255.0);

  timer = timerBegin(0, 80, true);
  timerAttachInterrupt(timer, &onTimer, true);
  timerAlarmWrite(timer, 24000, true); // 1.000.000 us = 1s
  timerAlarmEnable(timer);

}
//TESTAR RODAR FUNÇÃO E PREENCHER VETORES NO INICIO, LOOP WRITE VALORES
void displayOsci(byte * frame, int xres, int yres, double xo, double yo){
 int i,j,k,z,yi=yres,y2=(xres+1)*(yres+1)/8,stp=y2/(yres+1);
  for(k =y2; k >= stp; k-=stp){//2*yres+1=31
      z=k;
      for(j = 0;j <=xres ; j++){
        i=j;
        if(j>=8){
           i=j-8*(int)(j/8.0);
          z=k-(int)(j/8.0) ;
        }
        byte mask = 0x01 << i;
        byte answer = (frame[y2-z] & mask) >> i;
       // Serial.println(answer);
        if (answer != 0x01) {//!=0x01
          xval[j][yi]=(round((double)j * xo / (double)xres));//dac_output_voltage(DAC_CHANNEL_1, round((float)j * 255.0 / (float)xres));
          yval[j][yi]=(round((double)yi *  yo / (double)yres));//dac_output_voltage(DAC_CHANNEL_2, round((float)yi * 255.0 / (float)yres));
           // total++;
           /*Serial.print("j:");
           Serial.println(j);
           Serial.print("yi:");
           Serial.println(yi);*/
         // delayMicroseconds(100);
        }
        else{
          xval[j][yi]=-1;
        }
      }
    yi=yi-1;
  }
}



void loop() {
  /*
   DACPrepare(true);
  int i,j;
  for(i =yres; i >= 0; i--){
      for(j = 0;j <=xres ; j++){
        if((xval[j][i]!=-1)){
          DAC1Write(xval[j][i]);//dac_output_voltage(DAC_CHANNEL_1, xval[j][i]);
          DAC2Write(yval[j][i]);//dac_output_voltage(DAC_CHANNEL_2, yval[j][i]);
           /*Serial.print("x:");
           Serial.println(xval[j][i]);
           Serial.print("y:");
           Serial.println(yval[j][i]);*/
          //delayMicroseconds(10);
       /* }
        
      }
  }
   DACUnprepare(true);
   */
}
